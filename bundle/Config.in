## bundle/Config.in
```kconfig
source "$BR2_EXTERNAL/bundle/core-bundle/Config.in"
source "$BR2_EXTERNAL/bundle/extra-libs-bundle/Config.in"
source "$BR2_EXTERNAL/bundle/network-bundle/Config.in"
source "$BR2_EXTERNAL/bundle/python-bundle/Config.in"
source "$BR2_EXTERNAL/bundle/scientific-bundle/Config.in"
source "$BR2_EXTERNAL/bundle/web-bundle/Config.in"
source "$BR2_EXTERNAL/bundle/rpi-bundle/Config.in"
source "$BR2_EXTERNAL/bundle/fabui-bundle/Config.in"
```

## bundle/fabui-bundle/Config.in
```kconfig
config BR2_PACKAGE_FABUI_BUNDLE
	select BR2_PACKAGE_FABUI
	select BR2_PACKAGE_CURA_ENGINE
	select BR2_PACKAGE_AVRDUDE
	select BR2_PACKAGE_STRACE
	bool "fabui-bundle"
```

## bundle/kernel-bundle/Config.in
```kconfig
config BR2_PACKAGE_KERNEL_BUNDLE
	select BR2_LINUX_KERNEL
	select BR2_PACKAGE_LINUX_FIRMWARE
	select BR2_PACKAGE_LINUX_FIRMWARE_RTL_8188
	bool "kernel-bundle"
```

## bundle/network-bundle/Config.in
```kconfig
config BR2_PACKAGE_NETWORK_BUNDLE
	select BR2_PACKAGE_LIBCURL
	select BR2_PACKAGE_LIBMCRYPT
	select BR2_PACKAGE_IFLUGD
	select BR2_PACKAGE_IPTABLES
	select BR2_PACKAGE_WIRELESS_TOOLS
	select BR2_PACKAGE_WPA_SUPPLICANT
	bool "network-bundle"
```

## bundle/python-bundle/Config.in
```kconfig
config BR2_PACKAGE_PYTHON_BUNDLE
	select BR2_PACKAGE_PYTHON
	select BR2_PACKAGE_PYTHON_SERIAL
	select BR2_PACKAGE_PYTHON_RPI_GPIO
	select BR2_PACKAGE_PYTHON_NUMPY
	select BR2_PACKAGE_PYTHON_SCIPY
	select BR2_PACKAGE_PYTHON_REQUESTS
	bool "python-bundle"
```

## bundle/scientific-bundle/Config.in
```kconfig
config BR2_PACKAGE_SCIENTIFIC_BUNDLE
	select BR2_PACKAGE_CLAPACK
	select BR2_PACKAGE_OPENCV
	bool "scientific-bundle"
```

## configs/fabtotum_v1_defconfig
```kconfig
BR2_arm=y
BR2_arm1176jzf_s=y
BR2_ARM_EABIHF=y
BR2_WGET="wget --passive-ftp -nd -t 3 --no-check-certificate"
BR2_DL_DIR="$(TOPDIR)/../downloads"
BR2_OPTIMIZE_2=y
BR2_TOOLCHAIN_BUILDROOT_VENDOR="colibri"
BR2_KERNEL_HEADERS_3_12=y
BR2_TOOLCHAIN_BUILDROOT_EGLIBC=y
BR2_TOOLCHAIN_BUILDROOT_CXX=y
BR2_TOOLCHAIN_BUILDROOT_F77=y
BR2_GCC_ENABLE_GRAPHITE=y
BR2_TARGET_GENERIC_HOSTNAME="colibri"
BR2_TARGET_GENERIC_ISSUE="Welcome to Colibri"
BR2_ROOTFS_DEVICE_CREATION_DYNAMIC_MDEV=y
BR2_TARGET_GENERIC_GETTY_PORT="tty1"
# BR2_TARGET_GENERIC_REMOUNT_ROOTFS_RW is not set
BR2_LINUX_KERNEL=y
BR2_LINUX_KERNEL_CUSTOM_TARBALL=y
BR2_LINUX_KERNEL_CUSTOM_TARBALL_LOCATION="http://github.com/raspberrypi/linux/archive/rpi-3.16.y.tar.gz"
BR2_LINUX_KERNEL_USE_CUSTOM_CONFIG=y
BR2_LINUX_KERNEL_CUSTOM_CONFIG_FILE="$(BR2_EXTERNAL)/board/fabtotum/v1/linux-3.16.y-rpi.config"
BR2_LINUX_KERNEL_ZIMAGE=y
BR2_PACKAGE_BUSYBOX_CONFIG="$(BR2_EXTERNAL)/board/fabtotum/v1/busybox.config"
BR2_PACKAGE_BUSYBOX_SHOW_OTHERS=y
BR2_PACKAGE_LINUX_FIRMWARE=y
BR2_PACKAGE_LINUX_FIRMWARE_RTL_81XX=y
BR2_PACKAGE_RPI_FIRMWARE=y
BR2_PACKAGE_RPI_USERLAND=y
BR2_PACKAGE_RPI_USERLAND_START_VCFILED=y
BR2_PACKAGE_PHP_EXT_CALENDAR=y
BR2_PACKAGE_PHP_EXT_FILEINFO=y
BR2_PACKAGE_PHP_EXT_READLINE=y
BR2_PACKAGE_PHP_EXT_ZIP=y
BR2_PACKAGE_PHP_EXT_MCRYPT=y
BR2_PACKAGE_PHP_EXT_OPENSSL=y
BR2_PACKAGE_PHP_EXT_PDO=y
BR2_PACKAGE_PHP_EXT_PDO_SQLITE=y
BR2_PACKAGE_PHP_EXT_GETTEXT=y
BR2_PACKAGE_PHP_EXT_ICONV=y
BR2_PACKAGE_PHP_EXT_INTL=y
BR2_PACKAGE_PHP_EXT_MBSTRING=y
BR2_PACKAGE_PHP_EXT_JSON=y
BR2_PACKAGE_PHP_EXT_TOKENIZER=y
BR2_PACKAGE_PHP_EXT_CURL=y
BR2_PACKAGE_PHP_EXT_FTP=y
BR2_PACKAGE_PHP_EXT_SOCKETS=y
BR2_PACKAGE_PHP_EXT_CTYPE=y
BR2_PACKAGE_PHP_EXT_FILTER=y
BR2_PACKAGE_PHP_EXT_SIMPLEXML=y
BR2_PACKAGE_PHP_EXT_XML=y
BR2_PACKAGE_PHP_EXT_XMLREADER=y
BR2_PACKAGE_PHP_EXT_XMLWRITER=y
BR2_PACKAGE_PHP_SAPI_CLI_CGI=y
BR2_PACKAGE_PYTHON_BZIP2=y
BR2_PACKAGE_PYTHON_CURSES=y
BR2_PACKAGE_PYTHON_PYEXPAT=y
BR2_PACKAGE_PYTHON_READLINE=y
BR2_PACKAGE_PYTHON_SQLITE=y
BR2_PACKAGE_PYTHON_ZLIB=y
BR2_PACKAGE_PYTHON_HASHLIB=y
BR2_PACKAGE_OPENSSL_BIN=y
BR2_PACKAGE_OPENSSL_ENGINES=y
BR2_PACKAGE_SQLITE_READLINE=y
BR2_PACKAGE_SQLITE_ENABLE_FTS3=y
BR2_PACKAGE_SQLITE_ENABLE_UNLOCK_NOTIFY=y
BR2_PACKAGE_PCRE_16=y
BR2_PACKAGE_PCRE_32=y
BR2_PACKAGE_PCRE_UCP=y
BR2_PACKAGE_IFPLUGD=y
BR2_PACKAGE_LIGHTTPD_OPENSSL=y
BR2_PACKAGE_LIGHTTPD_ZLIB=y
BR2_PACKAGE_LIGHTTPD_BZIP2=y
BR2_PACKAGE_LIGHTTPD_PCRE=y
BR2_PACKAGE_WIRELESS_TOOLS_LIB=y
BR2_PACKAGE_WPA_SUPPLICANT_CLI=y
BR2_PACKAGE_WPA_SUPPLICANT_PASSPHRASE=y
BR2_TARGET_ROOTFS_COLIBRI=y
BR2_TARGET_ROOTFS_COLIBRI_XZ=y
BR2_ROOTFS_REMOVE_DOCUMENTATION=y
BR2_ROOTFS_REMOVE_DEVELOPMENT=y
BR2_PACKAGE_HOST_SQUASHFS=y
BR2_PACKAGE_CORE_BUNDLE=y
BR2_PACKAGE_EXTRA_LIBS_BUNDLE=y
BR2_PACKAGE_NETWORK_BUNDLE=y
BR2_PACKAGE_PYTHON_BUNDLE=y
BR2_PACKAGE_SCIENTIFIC_BUNDLE=y
BR2_PACKAGE_WEB_BUNDLE=y
BR2_PACKAGE_RPI_BUNDLE=y
BR2_PACKAGE_FABUI_BUNDLE=y
```

## package/cura-engine/Config.in
```kconfig
config BR2_PACKAGE_CURA_ENGINE
	bool "cura-engine"
	help
		The CuraEngine is a C++ console application for 3D printing GCode generation.
		
		https://github.com/Ultimaker/CuraEngine
```

## package/fabui/Config.in
```kconfig
config BR2_PACKAGE_FABUI
	bool "fabui"
	help
		FABTotum FAB-UI
		
		http://www.fabtotum.com
```
